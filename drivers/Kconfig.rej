## drivers/Kconfig.rej
```kconfig
diff a/drivers/Kconfig b/drivers/Kconfig	(rejected hunks)
@@ -225,4 +225,5 @@ source "drivers/sensors/Kconfig"
 
 source "drivers/esoc/Kconfig"
 
+source "drivers/kernelsu/Kconfig"
 endmenu
```
